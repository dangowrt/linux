## Documentation/devicetree/bindings/block/block-partition.yaml
```yaml
# SPDX-License-Identifier: GPL-2.0-only OR BSD-2-Clause
%YAML 1.2
---
$id: http://devicetree.org/schemas/block/block-partition.yaml#
$schema: http://devicetree.org/meta-schemas/core.yaml#

title: Partition on a block device

description: |
  This binding describes a partition on a block device.
  Partitions may be matched by a combination of partition number, name,
  and UUID.

maintainers:
  - Daniel Golle <daniel@makrotopia.org>

properties:
  $nodename:
    pattern: '^block-partition-.+$'

  compatible: true

  partition-number:
    description:
      Matches partition by number if present.

  partition-name:
    "$ref": "/schemas/types.yaml#/definitions/string"
    description:
      Matches partition by PARTNAME if present.

  partition-uuid:
    "$ref": "/schemas/types.yaml#/definitions/string"
    description:
      Matches partition by PARTUUID if present.

anyOf:
  - required:
      - partition-number

  - required:
      - partition-name

  - required:
      - partition-uuid

unevaluatedProperties: false
```

## Documentation/devicetree/bindings/mtd/partitions/ubi-volume.yaml
```yaml
# SPDX-License-Identifier: GPL-2.0-only OR BSD-2-Clause
%YAML 1.2
---
$id: http://devicetree.org/schemas/mtd/partitions/ubi-volume.yaml#
$schema: http://devicetree.org/meta-schemas/core.yaml#

title: UBI volume

description: |
  This binding describes a single UBI volume. Volumes can be matches either
  by their ID or their name, or both.

maintainers:
  - Daniel Golle <daniel@makrotopia.org>

properties:
  compatible: true

  volume-id:
    $ref: /schemas/types.yaml#/definitions/uint32
    description:
      Match UBI volume ID

  volume-name:
    $ref: /schemas/types.yaml#/definitions/string
    description:
      Match UBI volume name

anyOf:
  - required:
      - volume-id

  - required:
      - volume-name

unevaluatedProperties: false
```

## Documentation/devicetree/bindings/sound/mediatek,mt2701-hdmi-audio.yaml
```yaml
# SPDX-License-Identifier: (GPL-2.0-only OR BSD-2-Clause)
%YAML 1.2
---
$id: http://devicetree.org/schemas/sound/mediatek,mt2701-hdmi-audio.yaml#
$schema: http://devicetree.org/meta-schemas/core.yaml#

title: MediaTek MT2701 HDMI audio machine driver

maintainers:
  - Daniel Golle <daniel@makrotopia.org>

description:
  ASoC machine driver binding the MT2701 AFE HDMI playback path to
  the on-chip HDMI transmitter via the generic HDMI audio codec.
  The same HDMI audio IP is present on MT7623N.

properties:
  compatible:
    oneOf:
      - const: mediatek,mt2701-hdmi-audio
      - items:
          - const: mediatek,mt7623n-hdmi-audio
          - const: mediatek,mt2701-hdmi-audio

  mediatek,platform:
    $ref: /schemas/types.yaml#/definitions/phandle
    description: Phandle of the MT2701/MT7623N AFE platform node.

  mediatek,audio-codec:
    $ref: /schemas/types.yaml#/definitions/phandle
    description: Phandle of the HDMI transmitter acting as audio codec.

required:
  - compatible
  - mediatek,platform
  - mediatek,audio-codec

additionalProperties: false

examples:
  - |
    sound-hdmi {
        compatible = "mediatek,mt7623n-hdmi-audio",
                     "mediatek,mt2701-hdmi-audio";
        mediatek,platform = <&afe>;
        mediatek,audio-codec = <&hdmi0>;
    };
```
